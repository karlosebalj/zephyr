## prj.conf
```kconfig
CONFIG_PRINTK=y
# enable to use thread names
CONFIG_THREAD_NAME=y
```

## src/main.c
```c
/*
 * Copyright (c) 2012-2014 Wind River Systems, Inc.
 *
 * SPDX-License-Identifier: Apache-2.0
 */

#include "zephyr/sys/printk.h"
#include <zephyr/kernel.h>

// size of stack area used by each thread
#define STACKSIZE 1024

// scheduling priority used by each thread
#define PRIORITY 7

// delay between greetings (in ms)
#define SLEEPTIME 500

K_THREAD_STACK_DEFINE(threadA_stack_area, STACKSIZE);
static struct k_thread threadA_data;

/* threadA is a static thread that is spawned automatically */
void threadA(void *dummy1, void *dummy2, void *dummy3) {
  ARG_UNUSED(dummy1);
  ARG_UNUSED(dummy2);
  ARG_UNUSED(dummy3);

  printk("thread_a: thread started \n");
  while (1) {
    printk("thread_a: thread loop \n");
    k_msleep(SLEEPTIME);
  }
}

void main(void) {
  k_thread_create(&threadA_data, threadA_stack_area,
                  K_THREAD_STACK_SIZEOF(threadA_stack_area), threadA, NULL,
                  NULL, NULL, PRIORITY, 0, K_FOREVER);
  k_thread_name_set(&threadA_data, "thread_a");

  k_thread_start(&threadA_data);
}
```
